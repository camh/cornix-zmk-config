## boards/shields/cornix_dongle_eyelash/Kconfig.shield
```kconfig
config SHIELD_CORNIX_DONGLE_EYELASH
	def_bool $(shields_list_contains,cornix_dongle_eyelash)

#vim: set ft=kconfig:
```

## config/west.yml
```yaml
manifest:
  defaults:
    revision: v0.3
  remotes:
    - name: zmkfirmware
      url-base: https://github.com/zmkfirmware
    - name: cornix-shield
      url-base: https://github.com/hitsmaxft
    - name: urob
      url-base: https://github.com/urob
    - name: janpfischer
      url-base: https://github.com/janpfischer
  projects:
    - name: zmk
      remote: zmkfirmware
      import: app/west.yml
    - name: zmk-keyboard-cornix
      remote: cornix-shield
      revision: main
    - name: zmk-helpers
      remote: urob
      revision: main
    - name: zmk-rgbled-widget
      remote: hitsmaxft
      revision: main
      clone-depth: 1
    - name: zmk-dongle-display
      remote: hitsmaxft
      revision: main
      clone-depth: 1
    - name: zmk-dongle-screen
      remote: janpfischer
      revision: main
      clone-depth: 1
  self:
    path: config
```
